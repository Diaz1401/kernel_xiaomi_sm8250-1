## kernel/pgo/Kconfig
```kconfig
# SPDX-License-Identifier: GPL-2.0-only
menu "Profile Guided Optimization (PGO)"

config ARCH_SUPPORTS_PGO
       bool

config PGO_GEN
       bool "Enable profiling for kernel"
       depends on ARCH_SUPPORTS_PGO
       select GCOV_KERNEL if CC_IS_GCC
       select GCOV_PROFILE_ALL if CC_IS_GCC
       select PGO_CLANG if CC_IS_CLANG
       default n
       ---help---
       This option enables profile guided optimization for kernel.

       If unsure, say N.

config PGO_USE
       bool "Use generated profile to optimize the kernel"
       depends on ARCH_SUPPORTS_PGO
       default n
       ---help---
       This option use profile generated from profiling stage to optimize the kernel.

       If unsure, say N.

config PGO_CLANG
       bool "Enable clang's PGO-based kernel profiling"
       depends on PGO_GEN
       default n
       ---help---
       This option enables clang's PGO (Profile Guided Optimization) based
       code profiling to better optimize the kernel.

       If unsure, say N.

       Run a representative workload for your application on a kernel
       compiled with this option and download the raw profile file from
       /sys/kernel/debug/pgo/vmlinux.profraw. This file needs to be
       processed with llvm-profdata. It may be merged with other collected
       raw profiles.

       Copy the processed profile file into vmlinux.profdata, and enable
       KCFLAGS=-fprofile-use=vmlinux.profdata to produce an optimized
       kernel.

       Note that a kernel compiled with profiling flags will be
       significantly larger and run slower. Also be sure to exclude files
       from profiling which are not linked to the kernel image to prevent
       linker errors.

       Note that the debugfs filesystem has to be mounted to access
       profiling data.

endmenu
```
